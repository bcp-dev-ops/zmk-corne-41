&corne_5col_left_transform {
    compatible = "zmk,matrix-transform";
    columns = <5>;
    rows = <4>;
    col-offset = <0>;
    row-offset = <0>;
    map = <
         0   1   2   3   4
        10  11  12  13  14
        20  21  22  23  24
                30  31  32 
    >;
};

