&corne_5col_right_transform {
    compatible = "zmk,matrix-transform";
    columns = <5>;
    rows = <4>;
    col-offset = <0>;
    row-offset = <0>;
    map = <
         5   6   7   8   9
        15  16  17  18  19
        25  26  27  28  29
        33  34  35
    >;
};

