/* Placeholder for a future macro layer */
/* */
/* Corne Layout is based on 6 columns and 3 thumb keys */
/* To keep this layout 5-column, we simply keep the 1st and 12th column empty */
/* */
/* Left Hand                             Right Hand */
/* ┌────┬────┬────┬────┬────┬────┐       ┌────┬────┬────┬────┬────┬────┐ */
/* │ (0)│  1 │  2 │  3 │  4 │  5 │       │  6 │  7 │  8 │  9 │ 10 │    │ */
/* ├────┼────┼────┼────┼────┼────┤       ├────┼────┼────┼────┼────┼────┤ */
/* │    │ 13 │ 14 │ 15 │ 16 │ 17 │       │ 18 │ 19 │ 20 │ 21 │ 22 │    │ */
/* ├────┼────┼────┼────┼────┼────┤       ├────┼────┼────┼────┼────┼────┤ */
/* │    │ 25 │ 26 │ 27 │ 28 │ 29 │       │ 30 │ 31 │ 32 │ 33 │ 34 │    │ */
/* ├────┼────┼────┼────┼────┼────┤       ├────┼────┼────┼────┼────┼────┤ */
/* │    │    │    │ 36 │ 37 │ 38 │       │ 39 │ 40 │ 41 │    │    │    │ */
/* └────┴────┴────┴────┴────┴────┘       └────┴────┴────┴────┴────┴────┘ */
/* */
/* Macro Layer (Corne 5-column layout) */
/* Left Hand                             Right Hand */
/* ┌────┬────┬────┬────┬────┬────┐       ┌────┬────┬────┬────┬────┬────┐ */
/* │    │    │    │    │    │    │       │    │    │    │    │    │    │ */
/* ├────┼────┼────┼────┼────┼────┤       ├────┼────┼────┼────┼────┼────┤ */
/* │    │    │    │    │    │    │       │    │    │    │    │    │    │ */
/* ├────┼────┼────┼────┼────┼────┤       ├────┼────┼────┼────┼────┼────┤ */
/* │    │    │    │    │    │    │       │    │    │    │    │    │    │ */
/* ├────┼────┼────┼────┼────┼────┤       ├────┼────┼────┼────┼────┼────┤ */
/* │    │    │    │    │    │    │       │    │    │    │    │    │    │ */
/* └────┴────┴────┴────┴────┴────┘       └────┴────┴────┴────┴────┴────┘ */

navigation_windows: navigation_windows {
    display-name = "Navigation Windows";
    bindings = <
    /*  [SKIP-] [LEFT-----------------------------------------------------] [RIGHT HAND ------------------------------] [SKIP-]*/
        &none   &trans   &trans   &trans    &trans    &trans                &trans  &trans   &trans   &trans   &trans   &none
        &none   &trans   &trans   &trans    &trans    &trans                &trans  &trans   &trans   &trans   &trans   &none
        &none   &trans   &trans   &trans    &trans    &trans                &trans  &trans   &trans   &trans   &trans   &none
                                  &trans    &trans    &trans                &trans  &trans   &trans
    >;
};

