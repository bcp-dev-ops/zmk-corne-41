/* Implements Solid mouse (slow) layout */
/* See: https://github.com/vladsolokha/zmk-config/tree/main */

mouse_slow: mouse_slow {
    display-name = "Mouse Slow";
    bindings = <
        /* Top Row */
        /* ------------------------LEFT HAND -------*/    /* ------------------------RIGHT HAND -------------------------------------------------*/
        &trans   &trans   &trans   &trans   &trans           &trans   &trans              &mmv MOVE_Y(-900)  &trans             &trans

        /* Home Row */
        /* ------------------------LEFT HAND -------*/    /* ------------------------RIGHT HAND -------------------------------------------------*/
        &trans   &trans   &trans   &trans   &trans           &trans   &mmv MOVE_X(-900)   &mmv MOVE_Y(900)   &mmv MOVE_X(900)   &trans

        /* Bottom Row */
        /* ------------------------LEFT HAND -------*/    /* ------------------------RIGHT HAND -------------------------------------------------*/
        &trans   &trans   &trans   &trans   &trans           &trans   &trans              &trans             &trans             &trans


        /* Thumbs */
        /* ------------------------LEFT HAND -------*/    /* ------------------------RIGHT HAND -------------------------------------------------*/
                          &trans   &trans   &trans           &trans   &trans              &trans
    >;

};
