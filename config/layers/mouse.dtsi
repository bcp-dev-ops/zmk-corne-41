/* Implements Solid mouse layout */
/* See: https://github.com/vladsolokha/zmk-config/tree/main */

#include "behaviors/init.dtsi"
#include "macros/init.dtsi"

mouse: mouse {
    display-name = "Mouse";
    bindings = <
        /* Top Row */
        /* ------------------------LEFT HAND --------------------------*/   /* ------------------------RIGHT HAND -------------------------------------------------*/
        &none       &none      &none      &none         &none                 &none            &none             &none           &none             &none

        /* Home Row */
        /* ------------------------LEFT HAND --------------------------*/   /* ------------------------RIGHT HAND -------------------------------------------------*/
        &sk LALT    &trans     &sk LCMD   &sk LCTRL     &none                 &mmv MOVE_LEFT   &mmv MOVE_DOWN    &mmv MOVE_UP    &mmv MOVE_RIGHT   &mkp MCLK

        /* Bottom Row */
        /* ------------------------LEFT HAND --------------------------*/   /* ------------------------RIGHT HAND -------------------------------------------------*/
        &none       &none      &none      &none         &none                 &none            &msc SCRL_LEFT    &msc SCRL_DOWN  &msc SCRL_UP      &msc SCRL_RIGHT

        /* Thumbs */
        /* ------------------------LEFT HAND --------------------------*/   /* ------------------------RIGHT HAND -------------------------------------------------*/
                               &trans     &trans        &mo MOUSESLOW         &mkp LCLK        &mkp RCLK         &trans
    >;
};
