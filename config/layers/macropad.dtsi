/* Placeholder for a future macro layer */
/* */

#include "behaviors/init.dtsi"
#include "macros/init.dtsi"

macropad: macropad {
    display-name = "Macropad";
    bindings = <

        /* Top Row */
        /* ------------------------LEFT HAND --------------------------------------------*/   /* ------------------------RIGHT HAND --------------------------------------------*/
        &trans             &trans           &trans          &trans            &trans             &trans       &trans            &trans          &trans          &trans


        /* Home Row */
        /* ------------------------LEFT HAND --------------------------------------------*/   /* ------------------------RIGHT HAND --------------------------------------------*/
        &trans             &trans           &trans          &trans            &trans             &trans       &trans            &trans          &trans          &trans


        /* Bottom Row */
        /* ------------------------LEFT HAND --------------------------------------------*/   /* ------------------------RIGHT HAND --------------------------------------------*/
        &trans             &trans           &trans          &trans            &trans             &trans       &trans            &trans          &trans          &trans


        /* Thumbs */
        /* ------------------------LEFT HAND --------------------------------------------*/   /* ------------------------RIGHT HAND --------------------------------------------*/

                                                 &trans          &trans            &trans             &trans          &trans            &trans
    >;
};
