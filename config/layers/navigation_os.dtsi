/* Implements custom navigation layer for common os interactions */
/* */

navigation_os: navigation_os{
    display-name = "Navigation OS";
    bindings = <

        /* Top Row */
        /* ------------------------LEFT HAND -----------------------------------------------------------------------------------------------*/    /* ------------------------RIGHT HAND -------------------------------------------------------------------*/
        &cycle_app_switcher_backwards   &cycle_app_switcher_forwards    &cycle_space_backwards    &cycle_space_forwards    &app_tab_previous      &kp PG_UP           &trans              &trans             &trans              &trans


        /* Home Row */
        /* ------------------------LEFT HAND -----------------------------------------------------------------------------------------------*/    /* ------------------------RIGHT HAND -------------------------------------------------------------------*/
        &trans                          &trans                          &trans                    &trans                   &app_tab_next          &kp PG_DN           &hm RSHIFT LEFT     &hm RGUI DOWN      &hm RALT UP         &hm RCTRL RIGHT


        /* Bottom Row */
        /* ------------------------LEFT HAND -----------------------------------------------------------------------------------------------*/    /* ------------------------RIGHT HAND -------------------------------------------------------------------*/
        &navigate_window_left           &navigate_window_down           &navigate_window_up       &navigate_window_right   &trans                 &trans              &navigate_window_left    &navigate_window_down   &navigate_window_up      &navigate_window_right


        /* Thumbs */
        /* ------------------------LEFT HAND -----------------------------------------------------------------------------------------------*/    /* ------------------------RIGHT HAND -------------------------------------------------------------------*/

                                                                        &kp RPT                   &lt NAV BSPC             &lt SYM ESC            &lt FN ENTER        &lt MAGIC SPACE      &magic_key
    >;
};
