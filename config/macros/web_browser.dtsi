browser_history_back: browser_history_back {
    compatible = "zmk,behavior-macro";
    #binding-cells = <0>;
    bindings = <&macro_press &kp LGUI>
             , <&macro_tap &kp LBKT>
             , <&macro_release &kp LGUI>;
};

browser_history_forward: browser_history_forward {
    compatible = "zmk,behavior-macro";
    #binding-cells = <0>;
    bindings = <&macro_press &kp LGUI>
             , <&macro_tap &kp RBKT>
             , <&macro_release &kp LGUI>;
};
