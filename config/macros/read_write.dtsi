open: open {
    compatible = "zmk,behavior-macro";
    #binding-cells = <0>;
    bindings = <&macro_press &kp LGUI>
             , <&macro_tap &kp O>
             , <&macro_release &kp LGUI>;
};

save: save {
    compatible = "zmk,behavior-macro";
    #binding-cells = <0>;
    bindings = <&macro_press &kp LGUI>
             , <&macro_tap &kp S>
             , <&macro_release &kp LGUI>;
};
