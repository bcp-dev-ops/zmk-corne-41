mo_kp_tap: momentary_hold_key_press_tap_prefer {
    tapping-term-ms = <220>;
    compatible = "zmk,behavior-hold-tap";
    #binding-cells = <2>;
    flavor = "tap-preferred";
    quick-tap-ms = <200>;
    require-prior-idle-ms = <200>;
    bindings = <&mo>, <&kp>;
};
