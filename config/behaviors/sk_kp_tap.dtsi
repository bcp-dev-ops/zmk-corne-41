sk_kp_tap: sticky_key_press_tap_prefer {
        compatible = "zmk,behavior-hold-tap";
        #binding-cells = <2>;
        flavor = "tap-preferred";
        tapping-term-ms = <220>;
        quick-tap-ms = <180>;
        require-prior-idle-ms = <100>;
        bindings = <&sk>, <&kp>;
};

